/ {
	chosen {
		zmk,kscan = &default_kscan;
	};

	default_kscan: kscan {
		compatible = "zmk,kscan-gpio-direct";
		label = "default_kscan";

		input-gpios =
			<&pro_micro_d 1 (GPIO_ACTIVE_HIGH | GPIO_PULL_DOWN)>,
			<&pro_micro_d 0 (GPIO_ACTIVE_HIGH | GPIO_PULL_DOWN)>,
			<&pro_micro_d 2 (GPIO_ACTIVE_HIGH | GPIO_PULL_DOWN)>,
			<&pro_micro_d 3 (GPIO_ACTIVE_HIGH | GPIO_PULL_DOWN)>,
			<&pro_micro_d 4 (GPIO_ACTIVE_HIGH | GPIO_PULL_DOWN)>,
			<&pro_micro_d 5 (GPIO_ACTIVE_HIGH | GPIO_PULL_DOWN)>;
	};
};